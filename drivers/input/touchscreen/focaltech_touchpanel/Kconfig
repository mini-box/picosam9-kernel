## drivers/input/touchscreen/focaltech_touchpanel/Kconfig
```kconfig
#
# Mstar Touchscreen driver configuration
#

config TOUCHSCREEN_FT5X06
	tristate "FocalTech_FT5X06 based touchscreens"
	depends on I2C
	help
	  Say Y here if you have a touchscreen interface using the
	  FocalTech_FT5X06 controller, and your board-specific
	  setup code includes that in its table of I2C devices.

	  If unsure, say N (but it's safe to say "Y").

	  To compile this driver as a module, choose M here: the
	  module will be called ft5x06_ts.
```

## drivers/input/touchscreen/mstar_touchpanel/Kconfig
```kconfig
#
# Mstar Touchscreen driver configuration
#

config TOUCHSCREEN_MSTAR_MSG20XX
	tristate "MSTAR_MSG20XX based touchscreens"
	depends on I2C
	help
	  Say Y here if you have a touchscreen interface using the
	  MSTAR_MSG20XX controller, and your board-specific
	  setup code includes that in its table of I2C devices.

	  If unsure, say N (but it's safe to say "Y").

	  To compile this driver as a module, choose M here: the
	  module will be called touchscreen_msg20xx.
```
